## bsp/cc2538-smdz-breadfruit/Kconfig
```kconfig
mainmenu "RT-Thread Configuration"

config $BSP_DIR
    string
    option env="BSP_ROOT"
    default "."

config $RTT_DIR
    string
    option env="RTT_ROOT"
    default "../.."

config $PKGS_DIR
    string
    option env="PKGS_ROOT"
    default "packages"

source "$RTT_DIR/Kconfig"
source "$PKGS_DIR/Kconfig"

choice
    prompt "Device type"
    default CC2538SF53
    config CC2538SF53
        bool "CC2538SF53"
endchoice
config RT_USING_HSI
    bool "Using HSI as clock source"
    default n
config RT_HSE_VALUE
    int "HSE Value"
    default 8000000
    depends on !RT_USING_HSI


if RT_USING_SERIAL

    config RT_USING_UART1
        bool "Using uart1"
        default y    
endif

if RT_USING_SPI
    config RT_USING_SPI1
        bool "Using spi1"
        default y
    config RT_USING_SPI2
        bool "Using spi2"
        default n
endif
```
